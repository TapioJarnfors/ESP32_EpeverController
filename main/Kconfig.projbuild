## main/Kconfig.projbuild
```kconfig
menu "Epever Controller Configuration"

    config WIFI_SSID
        string "WiFi SSID"
        default "myssid"
        help
            SSID (network name) for the ESP32 to connect to.

    config WIFI_PASSWORD
        string "WiFi Password"
        default "mypassword"
        help
            WiFi password (WPA or WPA2) for the ESP32 to connect to.

    choice MQTT_BROKER_TYPE
        prompt "Select MQTT Broker"
        default MQTT_BROKER_MOSQUITTO
        help
            Choose which MQTT broker to use.

        config MQTT_BROKER_MOSQUITTO
            bool "Mosquitto (Local/LAN)"
            help
                Use local Mosquitto broker with plain MQTT (no TLS).

        config MQTT_BROKER_HIVEMQ
            bool "HiveMQ Cloud"
            help
                Use HiveMQ Cloud broker with TLS/SSL encryption.
    endchoice

    menu "Mosquitto Broker Settings"
        depends on MQTT_BROKER_MOSQUITTO

        config MQTT_BROKER_URI
            string "MQTT Broker URI"
            default "mqtt://192.168.1.210:1883"
            help
                URI of the MQTT broker to connect to.
                Format: mqtt://hostname:port

        config MQTT_USERNAME
            string "MQTT Username"
            default ""
            help
                Username for MQTT broker authentication.
                Leave empty if broker doesn't require authentication.

        config MQTT_PASSWORD
            string "MQTT Password"
            default ""
            help
                Password for MQTT broker authentication.
                Leave empty if broker doesn't require authentication.
    endmenu

    menu "HiveMQ Cloud Settings"
        depends on MQTT_BROKER_HIVEMQ

        config HIVEMQ_HOST
            string "HiveMQ Cloud Host"
            default "your-cluster.s1.eu.hivemq.cloud"
            help
                Your HiveMQ Cloud cluster hostname.
                Example: xxxxxxxx.s1.eu.hivemq.cloud

        config HIVEMQ_PORT
            int "HiveMQ Cloud Port"
            default 8883
            help
                HiveMQ Cloud TLS port (usually 8883).

        config HIVEMQ_USERNAME
            string "HiveMQ Username"
            default ""
            help
                Username for HiveMQ Cloud authentication (required).

        config HIVEMQ_PASSWORD
            string "HiveMQ Password"
            default ""
            help
                Password for HiveMQ Cloud authentication (required).
    endmenu

endmenu
```

## sdkconfig.defaults
```kconfig
# ESP32 Epever Controller - Default Configuration
# This file contains non-sensitive default values
# After cloning, run 'idf.py menuconfig' to set your actual credentials

#
# Epever Controller Configuration
#
# WiFi Configuration - CHANGE THESE IN MENUCONFIG
CONFIG_WIFI_SSID="your-wifi-ssid"
CONFIG_WIFI_PASSWORD="your-wifi-password"

# MQTT Broker Selection - Choose your broker type
# CONFIG_MQTT_BROKER_MOSQUITTO=y
CONFIG_MQTT_BROKER_HIVEMQ=y

#
# Mosquitto Broker Settings (if using local broker)
#
CONFIG_MQTT_BROKER_URI="mqtt://192.168.1.210:1883"
CONFIG_MQTT_USERNAME=""
CONFIG_MQTT_PASSWORD=""

#
# HiveMQ Cloud Settings (if using HiveMQ Cloud)
#
CONFIG_HIVEMQ_HOST="your-cluster.s1.eu.hivemq.cloud"
CONFIG_HIVEMQ_PORT=8883
CONFIG_HIVEMQ_USERNAME="your-hivemq-username"
CONFIG_HIVEMQ_PASSWORD="your-hivemq-password"

# MQTT Protocol Settings
CONFIG_MQTT_PROTOCOL_311=y
CONFIG_MQTT_TRANSPORT_SSL=y
CONFIG_MQTT_TRANSPORT_WEBSOCKET=y
CONFIG_MQTT_TRANSPORT_WEBSOCKET_SECURE=y
```
